## boards/arm/rumblepack_bt40_nrf5340/Kconfig.board
```kconfig
# Copyright (c) 2023 Nordic Semiconductor ASA
# SPDX-License-Identifier: Apache-2.0

config BOARD_RUMBLEPACK_BT40_NRF5340
	bool "rumblepack_BT40_nrf5340"
	depends on SOC_NRF5340_CPUAPP_QKAA
```

## boards/arm/rumblepack_bt40_nrf5340/Kconfig.defconfig
```kconfig
# Copyright (c) 2023 Nordic Semiconductor ASA
# SPDX-License-Identifier: Apache-2.0

if BOARD_RUMBLEPACK_BT40_NRF5340

config BOARD
	default "rumblepack_bt40_nrf5340"


endif
```

## boards/arm/rumblepack_bt40_nrf5340/Kconfig.rumblepack_BT40_nrf5340
```kconfig
# Copyright (c) 2023 Nordic Semiconductor ASA
# SPDX-License-Identifier: Apache-2.0

config BOARD_RUMBLEPACK_BT40_NRF5340
	select SOC_NRF5340_CPUAPP_QKAA if BOARD_RUMBLEPACK_BT40_NRF5340_CPUAPP
	select SOC_NRF5340_CPUNET_QKAA if BOARD_RUMBLEPACK_BT40_NRF5340_CPUNET
	# bool "rumblepack_BT40_nrf5340"
	# depends on SOC_NRF5340_CPUAPP_QKAA
```

## boards/arm/rumblepack_bt40_nrf5340/rumblepack_bt40_nrf5340_defconfig
```kconfig
# Copyright (c) 2023 Nordic Semiconductor ASA
# SPDX-License-Identifier: Apache-2.0

CONFIG_SOC_SERIES_NRF53X=y
CONFIG_SOC_NRF5340_CPUAPP_QKAA=y
CONFIG_BOARD_RUMBLEPACK_BT40_NRF5340=y

# Enable MPU
CONFIG_ARM_MPU=y

# Enable hardware stack protection
CONFIG_HW_STACK_PROTECTION=y

# Enable TrustZone-M
CONFIG_ARM_TRUSTZONE_M=y
```

## boards/arm/rumblepack_bt40_nrf5340_multicore/Kconfig.rumblepack_bt40_nrf5340_multicore
```kconfig
# rumblepack BT40 nRF5340 Multicore board configuration

# Copyright (c) 2019 Nordic Semiconductor ASA
# SPDX-License-Identifier: Apache-2.0

config BOARD_RUMBLEPACK_BT40_NRF5340_MULTICORE
	select SOC_NRF5340_CPUAPP_QKAA if BOARD_RUMBLEPACK_BT40_NRF5340_MULTICORE_NRF5340_CPUAPP
	select SOC_NRF5340_CPUAPP_QKAA if BOARD_RUMBLEPACK_BT40_NRF5340_MULTICORE_NRF5340_CPUAPP_NS
	select SOC_NRF5340_CPUNET_QKAA if BOARD_RUMBLEPACK_BT40_NRF5340_MULTICORE_NRF5340_CPUNET
```

## boards/arm/rumblepack_bt40_nrf5340_multicore/board.yml
```yaml
board:
  name: rumblepack_bt40_nrf5340_multicore
  vendor: jom
  socs:
  - name: 'nrf5340'
    variants:
    - name: 'ns'
      cpucluster: 'cpuapp'
```

## boards/arm/rumblepack_nrf52840/Kconfig.board
```kconfig
# Copyright (c) 2023 Nordic Semiconductor ASA
# SPDX-License-Identifier: Apache-2.0

config BOARD_RUMBLEPACK_NRF52840
	bool "rumblepack_nrf52840"
	depends on SOC_NRF52840_QIAA
```

## boards/arm/rumblepack_nrf52840/Kconfig.defconfig
```kconfig
# Copyright (c) 2023 Nordic Semiconductor ASA
# SPDX-License-Identifier: Apache-2.0

if BOARD_RUMBLEPACK_NRF52840

config BOARD
	default "rumblepack_nrf52840"

config BT_CTLR
   default BT

endif
```

## drivers/nau8325/Kconfig
```kconfig
# NAU8325 Stereo I2S Class-D Audio Amplifier

config NAU8325
    bool "NAU8325 Stereo Amplifier"
        default y
        select I2C
        select I2S

    help
      Enable I2S and I2C-based driver for NAU8325 audio amplifier

config NAU8325_LOG_LEVEL
    int
    default 4
```

## drivers/nau8325/dts/bindings/nuvoton,nau8325.yml
```yaml
description: Nuvoton NAU8325 Audio Driver

compatible: "nuvoton,nau8325"

include: i2c-device.yaml
```
